#include "charybdis.dtsi"
#include "charybdis_3610.dtsi"
#include "split_input_common.dtsi"

&default_transform {
	col-offset = <6>;
};

&kscan0 {
	compatible = "zmk,kscan-gpio-matrix";
	
	col-gpios
		= <&gpio0 2 (GPIO_ACTIVE_HIGH | GPIO_PULL_DOWN)>
		, <&gpio0 29 (GPIO_ACTIVE_HIGH | GPIO_PULL_DOWN)>
		, <&gpio0 9 (GPIO_ACTIVE_HIGH | GPIO_PULL_DOWN)>
		, <&gpio1 0  (GPIO_ACTIVE_HIGH | GPIO_PULL_DOWN)>
		, <&gpio0 11 (GPIO_ACTIVE_HIGH | GPIO_PULL_DOWN)>
		, <&gpio1 4  (GPIO_ACTIVE_HIGH | GPIO_PULL_DOWN)>
		;

	row-gpios
		= <&gpio0 31 GPIO_ACTIVE_HIGH>
		, <&gpio0 30 GPIO_ACTIVE_HIGH>
		, <&gpio0 28 GPIO_ACTIVE_HIGH>
		, <&gpio0 3 GPIO_ACTIVE_HIGH>
		, <&gpio1 13 GPIO_ACTIVE_HIGH>
		;
};

&trackball_split {
    device = <&trackball>;
};
